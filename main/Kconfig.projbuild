## main/Kconfig.projbuild
```kconfig
menu "Network Configuration"

    config STREAM_WIFI_SSID
        string "Wi-Fi AP SSID"
        default "Gestura-AP"
        help
            "Name of Wi-Fi network created for data stream; must be 31 chars or less"
    
    config STREAM_WIFI_PASSWD
        string "Wi-Fi AP password"
        default "Gestura-AP"
        help
            "Password of Wi-Fi network created for data stream; must be between 8 and 63 chars"

    config STREAM_WIFI_CHAN
        int "Wi-Fi AP channel"
        range 1 13
        default 1
    
    config STREAM_PORT
        int "Port of socket for stream"
        range 0 65535
        default 43800
        help
            "Port number used for the socket server for the data stream (note IP address is hardcoded to 192.168.0.1)"
endmenu

menu "GPIO Allocation"
    orsource "$IDF_PATH/examples/common_components/env_caps/$IDF_TARGET/Kconfig.env_caps"

    config FLEX_ADC_UNIT
        int "Flex sensor ADC unit number"
        default 1
    
    config FLEX_SHORT_ADC_CHAN
        int "Short flex sensor ADC channel number"
        default 5

    config FLEX_LONG_ADC_CHAN
        int "Long flex sensor ADC channel number"
        default 6

    config IMU_MOSI
        int "MOSI GPIO pin for IMU"
        default 21
    
    config IMU_MISO
        int "MISO GPIO pin for IMU"
        default 20
    
    config IMU_SCLK
        int "SCLK GPIO pin for IMU"
        default 19
    
    config IMU_CS
        int "CS GPIO pin for IMU"
        default 22
    
    config IMU_HINT
        int "Host interrupt GPIO pin for IMU"
        default 15
    
    config IMU_RST
        int "Reset GPIO pin for IMU"
        default 23
endmenu
```
